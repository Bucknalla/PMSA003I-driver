## drivers/pmsa003i/Kconfig
```kconfig
# Create a new option in menuconfig
config PMSA003I
	bool "PMSA003I Particulate Matter Sensor"
	default n  		# Set the driver to be disabled by default
	depends on I2C  # Make it dependent on I2C
	help
	  Enable driver for the PMSA003I particulate matter sensor. This driver
	  depends on the I2C subsystem being enabled.
```

## dts/bindings/sensor/plantower,pmsa003i.yaml
```yaml
# Description of the device
description: Plantower PMSA003I particulate matter sensor

# Compatibility string that matches the one in the Devicetree source and 
# DT_DRV_COMPAT macro in the driver source code
compatible: "plantower,pmsa003i"

# Includes common definitions from other bindings files
#  - sensor-device.yaml - common sensor properties
#  - i2c-device.yaml - common I2C communication properties
include: [sensor-device.yaml, i2c-device.yaml]

# Defines specific Devicetree properties of the PMSA003I sensor
properties:
  i2c-address:
    type: int
    default: 0x12
    description: I2C address of the PMSA003I sensor
```

## west.yml
```yaml
manifest:
  projects:
    - name: zephyr
      revision: main
      url: https://github.com/zephyrproject-rtos/zephyr
      import: true
    - name: pmsa003i-driver
      path: drivers/pmsa003i
      revision: main
  self:
    path: modules/lib/note-zephyr
```
